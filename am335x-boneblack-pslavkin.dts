/*
 * Copyright (C) 2012 Texas Instruments Incorporated - http://www.ti.com/
 *
 * This program is free software; you can redistribute it and/or modify
 * it under the terms of the GNU General Public License version 2 as
 * published by the Free Software Foundation.
 */
/dts-v1/;

#include "am335x-boneblack.dts"

/* pinmux i2c1 */
&am33xx_pinmux {
	i2c1_pins: pinmux_i2c1_pins {
		pinctrl-single,pins = <
			AM33XX_IOPAD(0x958, PIN_INPUT_PULLUP | MUX_MODE2) /* spi0_d1.i2c1_sda */
			AM33XX_IOPAD(0x95c, PIN_INPUT_PULLUP | MUX_MODE2) /* spi0_cs0.i2c1_scl */
		>;
	};
};

/* habilitamos el bus i2c1 */
&i2c1 {
	status = "okay";
	pinctrl-names = "default";
	clock-frequency = <100000>;
	pinctrl-0 = <&i2c1_pins>;

	/* aca declaramos nuestros devices */
	mpu9250_pslavkin: mpu9250_pslavkin@68 {
		compatible = "mse,mpu9250_pslavkin";
		reg = <0x68>;
	};
};

